## drivers/hotplug/Kconfig
```kconfig
config MSM_HOTPLUG
	bool "MSM hotplug driver"
	depends on HOTPLUG_CPU
	help
	  The MSM hotplug driver controls on-/offlining of additional cores based
	  on current cpu load.

config AUTOSMP
	bool "Multi-core automatic hotplug support"
	depends on SMP && HOTPLUG_CPU
	help
	  Automatically hotplugs the multiple cpu cores on and off
	  based on cpu load and suspend state

config INTELLI_HOTPLUG
	bool "Intelli hotplug driver"
	depends on HOTPLUG_CPU
	help
	  An intelligent cpu hotplug driver for
	  Low Latency Frequency Transition capable processors.

config BRICKED_HOTPLUG
	bool "Enable kernel based mpdecision"
	depends on MSM_RUN_QUEUE_STATS
	help
		This enables kernel based multi core control.
		(up/down hotplug based on load)
```
